## boards/shields/gamebad_mk2/Kconfig.defconfig
```kconfig
if SHIELD_GAMEBAD_MK2
config ZMK_KEYBOARD_NAME
  default "Gamebad Mk2"
config USB_DEVICE_MANUFACTURER
  default "TheHonker"
config SPI
  default y
config GPIO_595
  default y
config ZMK_USB
  default y
config ZMK_USB_BOOT
  default y
config ZMK_BATTERY_REPORTING
  default y
config ZMK_BLE
  default y
config ZMK_BLE_EXPERIMENTAL_FEATURES
  default y
config MK_BLE_PASSKEY_ENTRY
  default y
config ZMK_HID_REPORT_TYPE_NKRO
  default y
config ZMK_HID_KEYBOARD_NKRO_EXTENDED_REPORT
  default y
config ZMK_HID_CONSUMER_REPORT_USAGES_FULL
  default y
config ZMK_BLE_CONSUMER_REPORT_QUEUE_SIZE
  default 1
config ZMK_BLE_KEYBOARD_REPORT_QUEUE_SIZE
  default 5
endif
```

## boards/shields/gamebad_mk3/Kconfig.defconfig
```kconfig
if SHIELD_GAMEBAD_MK3
config ZMK_KEYBOARD_NAME
  default "Gamebad Mk3"
config USB_DEVICE_MANUFACTURER
  default "TheHonker"
endif
```
