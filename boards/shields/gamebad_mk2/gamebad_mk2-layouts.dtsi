#include <physical_layouts.dtsi>

/ {
  physical_layout0: physical_layout0 {
    compatible = "zmk,physical-layout";
    display-name = "Default Layout";
    kscan = <&kscan0>;
    transform = <&keymap_transform0>;
  };
};
